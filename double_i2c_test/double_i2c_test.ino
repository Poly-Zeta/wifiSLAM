#include <Wire.h>
#include <Arduino.h>

#define Wire1_SDA (19)
#define Wire1_SCL (18)

#define MAINLOOP_CYCLE_MS 10

#define SSD1306_PAGES_SIZE 8//0~7の8ページ(64pix/8pix)
#define SSD1306_CHARS_SIZE 16//1ページには16文字(128pix/8pix)
#define SSD1306_CHARLINEDATA_SIZE 8//1文字は8line*1Byte

#define FONTDATA_SIZE 59
#define FONTDATA_OFFSET 0x20

#define SENSORS 23
#define SENSORS_DISPLAY_OFFSET 12

TaskHandle_t thp[1];//マルチスレッドのタスクハンドル格納用
const uint8_t delay_th=MAINLOOP_CYCLE_MS-2;

const uint8_t ADDRESS_SSD1306  =  0x3C;

//センサデータ置き場
double sensorsDataBuffer[SENSORS]={0,0,0,0,0,0,0,0,0,0,0,0,0,0,0,0,0,0,0,0,0,0,0};
int32_t EncodeTotal[4]={0,0,0,0};

uint16_t I2CActiveFlags=0b0000000000000000;

signed long int t_fine;
uint16_t dig_T1,dig_P1;
int16_t dig_T2,dig_T3,dig_P2,dig_P3,dig_P4,dig_P5,dig_P6,dig_P7,dig_P8,dig_P9,dig_H2,dig_H4,dig_H5;
int8_t  dig_H1,dig_H3,dig_H6;

enum SensorsBufferNUM{
  GYRO_X, //0
  GYRO_Y, //1
  GYRO_Z, //2
  MAG_X,  //3
  MAG_Y,  //4
  MAG_Z,  //5
  ACC_X,  //6
  ACC_Y,  //7
  ACC_Z,  //8
  LACC_X, //9
  LACC_Y, //10
  LACC_Z, //11
  QW,     //12
  QX,     //13
  QY,     //14
  QZ,     //15
  HUMID,  //16
  TEMP,   //17
  PRESS,  //18
  L_WHEEL,//19
  R_WHEEL,//20
  A_IN0,  //21
  A_IN1   //22
};

enum I2CSensorsNUM{
  IMU_BNO055,   //00
  DISP_SSD1306, //01
  HUM_BME280,   //02
  WHEELS,       //03
  LED_BlinkM,   //04
  ADC_ADS1115,  //05
  SERVO_PCA9685 //06
};

//ディスプレイ描画バッファ
uint8_t ssd1306_displayBuffer[SSD1306_PAGES_SIZE][SSD1306_CHARS_SIZE]={
  {0x60,0x60,0x60,0x60,0x60,0x60,0x60,0x60,0x60,0x60,0x60,0x60,0x60,0x60,0x60,0x60},
  {0x60,0x60,0x60,0x60,0x60,0x60,0x60,0x60,0x60,0x60,0x60,0x60,0x60,0x60,0x60,0x60},
  {0x60,0x60,0x60,0x60,0x60,0x60,0x60,0x60,0x60,0x60,0x60,0x60,0x60,0x60,0x60,0x60},
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  {0x60,0x60,0x60,0x60,0x60,0x60,0x60,0x60,0x60,0x60,0x60,0x60,0x60,0x60,0x60,0x60}
};

//フォントデータ
const uint8_t fonts[FONTDATA_SIZE][SSD1306_CHARLINEDATA_SIZE]={
  {0x00,0x00,0x00,0x00,0x00,0x00,0x00,0x00},//   20
  {0x00,0x00,0x00,0x00,0x00,0x00,0x00,0x00},// ! 21 nodata
  {0x00,0x00,0x00,0x00,0x00,0x00,0x00,0x00},// " 22 nodata
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  {0x00,0xC6,0xC6,0xE6,0xD6,0xCE,0xC6,0xC6}// Z 5A
};

//導通チェックしてフラグ書き換え
void I2CConnectChk(int sensorAddr,int sensorNum){
  byte error;
  Wire1.beginTransmission(sensorAddr);
  error = Wire1.endTransmission();
  if(error==0){
    I2CActiveFlags=I2CActiveFlags | (1<<sensorNum);
  }
  return;
}

bool I2CConnectFlgChk(int sensorNum){
  bool flg;
  flg=(I2CActiveFlags>>sensorNum) & 0x01;
  
  return flg;
}

//OLED SSD1306 表示テスト 全フォントを書いていく
void SSD1306_FullFillSample(){
  int fontCount=0;
  uint8_t chara,page,cntByteLine;
  if(!I2CConnectFlgChk(DISP_SSD1306)){
    return;
  }

  for(page=0;page<SSD1306_PAGES_SIZE;page++){//全ページを対象

    Wire1.beginTransmission(ADDRESS_SSD1306);

    //ページ指定
    Wire1.write(0b10000000); //control byte, Co bit = 1 (1byte only), D/C# = 0 (command)
      Wire1.write(0xB0 | page); //set page start address(B0～B7)

    //表示更新幅指定っぽい
    Wire1.write(0b00000000);
      Wire1.write(0x21); //set Column Address
        Wire1.write(0); //Column Start Address(0-127)
        Wire1.write(127); //Column Stop Address(0-127)

    Wire1.endTransmission();

    for(chara=0;chara<SSD1306_CHARS_SIZE;chara++){//ページ内全文字を対象
      Wire1.beginTransmission(ADDRESS_SSD1306);
      Wire1.write(0b01000000); //control byte, Co bit = 0 (continue), D/C# = 1 (data) Max=31byte

      for(cntByteLine=0;cntByteLine<SSD1306_CHARLINEDATA_SIZE;cntByteLine++){
        Wire1.write(fonts[fontCount][cntByteLine]);
      }
      Wire1.endTransmission();

      //どの文字を表示するか決定．配列の添え字．
      fontCount++;
      if(fontCount>=FONTDATA_SIZE){
        fontCount=0;
      }
    }
  }
  return;
}

//OLED SSD1306 初期化
void SSD1306_Init(){
  I2CConnectChk(ADDRESS_SSD1306,DISP_SSD1306);
  if(!I2CConnectFlgChk(DISP_SSD1306)){
    return;
  }

  Wire1.beginTransmission(ADDRESS_SSD1306);//※このバイトも含め、以後、合計32byteまで送信できる

  Wire1.write(0b10000000); //control byte, Co bit = 1, D/C# = 0 (command)
  Wire1.write(0xAE); //display off
  
  Wire1.write(0b00000000); //control byte, Co bit = 0, D/C# = 0 (command)
    Wire1.write(0xA8); //Set Multiplex Ratio  0xA8, 0x3F
      Wire1.write(0b00111111); //64MUX

  Wire1.write(0b00000000); //control byte, Co bit = 0, D/C# = 0 (command)    
    Wire1.write(0xD3); //Set Display Offset 0xD3, 0x00
      Wire1.write(0x00);

  Wire1.write(0b10000000); //control byte, Co bit = 1, D/C# = 0 (command)
    Wire1.write(0x40); //Set Display Start Line 0x40

  Wire1.write(0b10000000); //control byte, Co bit = 1, D/C# = 0 (command)
    Wire1.write(0xA0); //Set Segment re-map 0xA0/0xA1

  Wire1.write(0b10000000); //control byte, Co bit = 1, D/C# = 0 (command)
    Wire1.write(0xC0); //Set COM Output Scan Direction 0xC0,/0xC8

  Wire1.write(0b00000000); //control byte, Co bit = 0, D/C# = 0 (command)
    Wire1.write(0xDA); //Set COM Pins hardware configuration 0xDA, 0x02
      Wire1.write(0b00010010);

  Wire1.write(0b00000000); //control byte, Co bit = 0, D/C# = 0 (command)
    Wire1.write(0x81); //Set Contrast Control 0x81, default=0x7F
      Wire1.write(255); //0-255

  Wire1.write(0b10000000); //control byte, Co bit = 1, D/C# = 0 (command)
    Wire1.write(0xA4); //Disable Entire Display On

  Wire1.write(0b00000000); //control byte, Co bit = 0, D/C# = 0 (command)
    Wire1.write(0xA6); //Set Normal Display 0xA6, Inverse display 0xA7

  Wire1.write(0b00000000); //control byte, Co bit = 0, D/C# = 0 (command)
    Wire1.write(0xD5); //Set Display Clock Divide Ratio/Oscillator Frequency 0xD5, 0x80
      Wire1.write(0b10000000);

  Wire1.write(0b00000000); //control byte, Co bit = 0, D/C# = 0 (command)
    Wire1.write(0x20); //Set Memory Addressing Mode
      Wire1.write(0x10); //Page addressing mode

  Wire1.endTransmission();

  Wire1.beginTransmission(ADDRESS_SSD1306);

  Wire1.write(0b00000000); //control byte, Co bit = 0, D/C# = 0 (command)
    Wire1.write(0x22); //Set Page Address
      Wire1.write(0); //Start page set
      Wire1.write(7); //End page set

  Wire1.write(0b00000000); //control byte, Co bit = 0, D/C# = 0 (command)
    Wire1.write(0x21); //set Column Address
      Wire1.write(0); //Column Start Address
      Wire1.write(127); //Column Stop Address

  Wire1.write(0b00000000); //control byte, Co bit = 0, D/C# = 0 (command)
    Wire1.write(0x8D); //Set Enable charge pump regulator 0x8D, 0x14
      Wire1.write(0x14);

  Wire1.write(0b10000000); //control byte, Co bit = 1, D/C# = 0 (command)
    Wire1.write(0xAF); //Display On 0xAF

  Wire1.endTransmission();

  return;
}

//OLED SSD1306 表示全クリア
void SSD1306_ClearAll(){
  uint8_t i, j, k;
  if(!I2CConnectFlgChk(DISP_SSD1306)){
    return;
  }
  
  for(i = 0; i < SSD1306_PAGES_SIZE; i++){//Page(0-7)
    Wire1.beginTransmission(ADDRESS_SSD1306);
      Wire1.write(0b10000000); //control byte, Co bit = 1 (1byte only), D/C# = 0 (command)
        Wire1.write(0xB0 | i); //set page start address(B0～B7)
      Wire1.write(0b00000000);
        Wire1.write(0x21); //set Column Address
          Wire1.write(0); //Column Start Address(0-127)
          Wire1.write(127); //Column Stop Address(0-127)
    Wire1.endTransmission();
  
    for(j = 0; j < SSD1306_CHARS_SIZE; j++){//column = 8byte x 16
      Wire1.beginTransmission(ADDRESS_SSD1306);
      Wire1.write(0b01000000); //control byte, Co bit = 0 (continue), D/C# = 1 (data)
      for(k = 0; k < SSD1306_CHARLINEDATA_SIZE; k++){ //continue to 31byte
        Wire1.write(0x00);
      }
      Wire1.endTransmission();
    }
  }
  return;
}

void setup(){
  Serial.begin(115200);
//   Wire1.begin();
  Wire1.begin(Wire1_SDA, Wire1_SCL);


  Wire1.setClock(100000L);
  delay(10);
  byte error;

  
  SSD1306_Init(); //OLED ssd1306 初期化
  
  SSD1306_ClearAll();
  delay(300);
  SSD1306_FullFillSample();
  delay(300);
  SSD1306_ClearAll();
  delay(300);

}

void loop() {
    SSD1306_ClearAll();
    delay(3000);
    SSD1306_FullFillSample();
    delay(3000);
}